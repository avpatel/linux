## drivers/firmware/riscv/Kconfig
```kconfig
# SPDX-License-Identifier: GPL-2.0-only
menu "Risc-V Specific firmware drivers"
depends on RISCV

config RISCV_SBI_SSE
	bool "Enable SBI Supervisor Software Events support"
	depends on RISCV_SBI && MMU && !HIBERNATION
	default y
	help
	  The Supervisor Software Events support allows the SBI to deliver
	  NMI-like notifications to the supervisor mode software. When enabled,
	  this option provides support to register callbacks on specific SSE
	  events.

	  Hibernation is not supported because firmware registrations do not
	  survive restoring a kernel image.

endmenu
```

## drivers/hwtracing/gtrace/Kconfig
```kconfig
# SPDX-License-Identifier: GPL-2.0-only

menuconfig GTRACE
	tristate "Generic Hardware Trace Support"
	depends on OF
	help
	  This framework provides an architecture-neutral kernel interface
	  for hardware trace drivers. It builds a topological view of the
	  trace components and configures the correct series of components
	  when trace is enabled. It is intended to be shared across RISC-V
	  and ARM trace components so that a single trace path may span
	  components of different architectures.

	  To compile this driver as a module, choose M here: the module
	  will be called gtrace.
```

## drivers/resctrl/Kconfig
```kconfig
menuconfig ARM64_MPAM_DRIVER
	bool "MPAM driver"
	depends on ARM64 && ARM64_MPAM
	select ACPI_MPAM if ACPI
	help
	  Memory System Resource Partitioning and Monitoring (MPAM) driver for
	  System IP, e.g. caches and memory controllers.

if ARM64_MPAM_DRIVER

config ARM64_MPAM_DRIVER_DEBUG
	bool "Enable debug messages from the MPAM driver"
	help
	  Say yes here to enable debug messages from the MPAM driver.

config MPAM_KUNIT_TEST
	bool "KUnit tests for MPAM driver " if !KUNIT_ALL_TESTS
	depends on KUNIT=y
	default KUNIT_ALL_TESTS
	help
	  Enable this option to run tests in the MPAM driver.

	  If unsure, say N.

endif

config ARM64_MPAM_RESCTRL_FS
	bool
	default y if ARM64_MPAM_DRIVER && RESCTRL_FS
	select RESCTRL_RMID_DEPENDS_ON_CLOSID
	select RESCTRL_ASSIGN_FIXED

menuconfig RISCV_CBQRI
	bool "RISC-V CBQRI support"
	depends on RISCV && RISCV_ISA_SSQOSID
	select ARCH_HAS_CPU_RESCTRL
	default y
	help
	  Capacity and Bandwidth QoS Register Interface (CBQRI) support for
	  RISC-V cache QoS resources. CBQRI exposes cache capacity
	  allocation through the resctrl filesystem at /sys/fs/resctrl when
	  RESCTRL_FS is also enabled.

if RISCV_CBQRI

config RISCV_CBQRI_CAPACITY
	bool "RISC-V CBQRI cache capacity-allocation controller"
	depends on OF
	help
	  Enable driver for a RISC-V CBQRI capacity controller that
	  governs a CPU cache, matching the "riscv,cbqri-capacity-controller"
	  compatible. The controller's cache phandle gives the cache level and
	  id, which the driver registers as a resctrl cache-allocation resource.

	  Say N unless your device tree describes a CBQRI capacity controller.

endif

config RISCV_CBQRI_RESCTRL_FS
	bool
	default y if RISCV_CBQRI && RESCTRL_FS
```

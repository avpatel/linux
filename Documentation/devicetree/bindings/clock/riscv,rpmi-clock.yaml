## Documentation/devicetree/bindings/riscv/riscv,trace-component.yaml
```yaml
# SPDX-License-Identifier: (GPL-2.0-only OR BSD-2-Clause)
%YAML 1.2
---
$id: http://devicetree.org/schemas/riscv/riscv,trace-component.yaml#
$schema: http://devicetree.org/meta-schemas/core.yaml#

title: RISC-V Trace Component

maintainers:
  - Anup Patel <anup@brainfault.org>

description:
  The RISC-V trace control interface specification standard memory mapped
  components (or devices) which support both the RISC-V efficient trace
  (E-trace) protocol and the RISC-V Nexus-based trace (N-trace) protocol.
  The RISC-V trace components have implementation specific directed acyclic
  graph style interdependency where output of one component serves as input
  to another component and certain components (such as funnel) can take inputs
  from multiple components. The type and version of a RISC-V trace component
  can be discovered from it's IMPL memory mapped register hence component
  specific compatible strings are not needed.

properties:
  compatible:
    items:
      - enum:
          - qemu,trace-component
      - const: riscv,trace-component

  reg:
    maxItems: 1

  cpus:
    maxItems: 1
    description:
      phandle to the cpu to which the RISC-V trace component is bound.

  in-ports:
    $ref: /schemas/graph.yaml#/properties/ports
    patternProperties:
      '^port(@[0-7])?$':
        description: Input connections from RISC-V trace component
        $ref: /schemas/graph.yaml#/properties/port

  out-ports:
    $ref: /schemas/graph.yaml#/properties/ports
    patternProperties:
      '^port(@[0-7])?$':
        description: Output connections from RISC-V trace component
        $ref: /schemas/graph.yaml#/properties/port

required:
  - compatible
  - reg

unevaluatedProperties: false

examples:
  - |
    // Example 1 (Per-hart encoder and ramsink components):

    encoder@c000000 {
      compatible = "qemu,trace-component", "riscv,trace-component";
      reg = <0xc000000 0x1000>;
      cpus = <&CPU0>;
      out-ports {
        port {
          CPU0_ENCODER_OUTPUT: endpoint {
            remote-endpoint = <&CPU0_RAMSINK_INPUT>;
          };
        };
      };
    };

    ramsink@c001000 {
      compatible = "qemu,trace-component", "riscv,trace-component";
      reg = <0xc001000 0x1000>;
      cpus = <&CPU0>;
      in-ports {
        port {
          CPU0_RAMSINK_INPUT: endpoint {
          };
        };
      };
    };

    encoder@c002000 {
      compatible = "qemu,trace-component", "riscv,trace-component";
      reg = <0xc002000 0x1000>;
      cpus = <&CPU1>;
      out-ports {
        port {
          CPU1_ENCODER_OUTPUT: endpoint {
            remote-endpoint = <&CPU1_RAMSINK_INPUT>;
          };
        };
      };
    };

    ramsink@c003000 {
      compatible = "qemu,trace-component", "riscv,trace-component";
      reg = <0xc003000 0x1000>;
      cpus = <&CPU1>;
      in-ports {
        port {
          CPU1_RAMSINK_INPUT: endpoint {
          };
        };
      };
    };

...
```

## drivers/hwtracing/rvtrace/Kconfig
```kconfig
# SPDX-License-Identifier: GPL-2.0-only

menuconfig RVTRACE
	tristate "RISC-V Trace Support"
	depends on RISCV
	depends on OF
	select PERF_EVENTS
	default RISCV
	help
	  This framework provides a kernel interface for the RISC-V trace
	  drivers (including both e-trace and n-trace). It's intended to
	  build a topological view of the RISC-V trace components and
	  configure the right series of components when trace is enabled
	  on a CPU.

	  To compile this driver as a module, choose M here: the module
	  will be called rvtrace.

config RVTRACE_ENCODER
	tristate "RISC-V Trace Encoder driver"
	depends on RVTRACE
	default y
	help
	  This driver provides support for RISC-V Trace Encoder component.

config RVTRACE_RAMSINK
	tristate "RISC-V Trace Ramsink driver"
	depends on RVTRACE
	select DMA_SHARED_BUFFER
	default y
	help
	  This driver provides support for Risc-V E-Trace Ramsink
	  component.
```

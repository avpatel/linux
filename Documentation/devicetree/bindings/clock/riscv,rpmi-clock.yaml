## Documentation/devicetree/bindings/clock/riscv,rpmi-clock.yaml
```yaml
# SPDX-License-Identifier: (GPL-2.0-only OR BSD-2-Clause)
%YAML 1.2
---
$id: http://devicetree.org/schemas/clock/riscv,rpmi-clock.yaml#
$schema: http://devicetree.org/meta-schemas/core.yaml#

title: RISC-V RPMI clock service group based clock controller

maintainers:
  - Anup Patel <anup@brainfault.org>

description: |
  The RISC-V Platform Management Interface (RPMI) [1] defines a
  messaging protocol which is modular and extensible. The supervisor
  software can send/receive RPMI messages via SBI MPXY extension [2]
  or some dedicated supervisor-mode RPMI transport.

  The RPMI specification [1] defines clock service group for accessing
  system clocks managed by a platform microcontroller.

  ===========================================
  References
  ===========================================

  [1] RISC-V Platform Management Interface (RPMI)
      https://github.com/riscv-non-isa/riscv-rpmi/releases

  [2] RISC-V Supervisor Binary Interface (SBI)
      https://github.com/riscv-non-isa/riscv-sbi-doc/releases

properties:
  compatible:
    oneOf:
      - description:
          Intended for use by the SBI implementation in machine mode or
          software in supervisor mode.
        const: riscv,rpmi-clock

      - description:
          Intended for use by the SBI implementation in machine mode.
        const: riscv,rpmi-mpxy-clock

  mboxes:
    maxItems: 1
    description:
      Mailbox channel of the underlying RPMI transport or SBI message proxy.

  riscv,sbi-mpxy-channel-id:
    $ref: /schemas/types.yaml#/definitions/uint32
    description:
      The SBI MPXY channel id to be used for providing RPMI access to
      the supervisor software. This property is mandatory when using
      riscv,rpmi-mpxy-clock compatible string.

  "#clock-cells":
    const: 1
    description:
      This property is mandatory when using riscv,rpmi-clock compatible string.

required:
  - compatible
  - mboxes

additionalProperties: false

examples:
  - |
    mpxy_mbox: sbi-mpxy-mbox {
          compatible = "riscv,sbi-mpxy-mbox";
          #mbox-cells = <2>;
    };
    rpmi-clk {
        compatible = "riscv,rpmi-clock";
        mboxes = <&mpxy_mbox 0x1000 0x0>;
        #clock-cells = <1>;
    };
...
```

## Documentation/devicetree/bindings/interrupt-controller/riscv,rpmi-system-msi.yaml
```yaml
# SPDX-License-Identifier: (GPL-2.0-only OR BSD-2-Clause)
%YAML 1.2
---
$id: http://devicetree.org/schemas/interrupt-controller/riscv,rpmi-system-msi.yaml#
$schema: http://devicetree.org/meta-schemas/core.yaml#

title: RISC-V RPMI system MSI service group based interrupt controller

maintainers:
  - Anup Patel <anup@brainfault.org>

description: |
  The RISC-V Platform Management Interface (RPMI) [1] defines a
  messaging protocol which is modular and extensible. The supervisor
  software can send/receive RPMI messages via SBI MPXY extension [2]
  or some dedicated supervisor-mode RPMI transport.

  The RPMI specification [1] defines system MSI service group which
  allow application processors to receive MSIs upon system events
  such as P2A doorbell, graceful shutdown/reboot request, CPU hotplug
  event, memory hotplug event, etc from the platform microcontroller.

  ===========================================
  References
  ===========================================

  [1] RISC-V Platform Management Interface (RPMI)
      https://github.com/riscv-non-isa/riscv-rpmi/releases

  [2] RISC-V Supervisor Binary Interface (SBI)
      https://github.com/riscv-non-isa/riscv-sbi-doc/releases

allOf:
  - $ref: /schemas/interrupt-controller.yaml#

properties:
  compatible:
    oneOf:
      - description:
          Intended for use by the SBI implementation in machine mode or
          software in supervisor mode.
        const: riscv,rpmi-system-msi

      - description:
          Intended for use by the SBI implementation in machine mode.
        const: riscv,rpmi-mpxy-system-msi

  mboxes:
    maxItems: 1
    description:
      Mailbox channel of the underlying RPMI transport or SBI message proxy.

  riscv,sbi-mpxy-channel-id:
    $ref: /schemas/types.yaml#/definitions/uint32
    description:
      The SBI MPXY channel id to be used for providing RPMI access to
      the supervisor software. This property is mandatory when using
      riscv,rpmi-mpxy-system-msi compatible string.

  msi-parent: true

  interrupt-controller: true

  "#interrupt-cells":
    const: 1

required:
  - compatible
  - mboxes
  - msi-parent
  - interrupt-controller
  - "#interrupt-cells"

additionalProperties: false

examples:
  - |
    mpxy_mbox: sbi-mpxy-mbox {
          compatible = "riscv,sbi-mpxy-mbox";
          #mbox-cells = <2>;
    };
    rpmi_sysmsi_intc: interrupt-controller {
        compatible = "riscv,rpmi-system-msi";
        mboxes = <&mpxy_mbox 0x2000 0x0>;
        msi-parent = <&imsic_slevel>;
        interrupt-controller;
        #interrupt-cells = <1>;
    };
...
```

## Documentation/devicetree/bindings/iommu/riscv,iommu.yaml
```yaml
# SPDX-License-Identifier: (GPL-2.0-only OR BSD-2-Clause)
%YAML 1.2
---
$id: http://devicetree.org/schemas/iommu/riscv,iommu.yaml#
$schema: http://devicetree.org/meta-schemas/core.yaml#

title: RISC-V IOMMU Implementation

maintainers:
  - Tomasz Jeznach <tjeznach@rivosinc.com>

description:
  The RISC-V IOMMU specificaiton defines an IOMMU for RISC-V platforms
  which can be a regular platform device or a PCI device connected to
  the host root port.

  The RISC-V IOMMU provides two stage translation, device directory table,
  command queue and fault reporting as wired interrupt or MSIx event for
  both PCI and platform devices.

  Visit https://github.com/riscv-non-isa/riscv-iommu for more details.

properties:
  compatible:
    oneOf:
      - description: RISC-V IOMMU as a platform device
        items:
          - enum:
              - vendor,chip-iommu
          - const: riscv,iommu

      - description: RISC-V IOMMU as a PCI device connected to root port
        items:
          - enum:
              - vendor,chip-pci-iommu
          - const: riscv,pci-iommu

  reg:
    maxItems: 1
    description:
      For RISC-V IOMMU as a platform device, this represents the MMIO base
      address of registers.

      For RISC-V IOMMU as a PCI device, this represents the PCI-PCI bridge
      details as described in Documentation/devicetree/bindings/pci/pci.txt

  '#iommu-cells':
    const: 2
    description: |
      Each IOMMU specifier represents the base device ID and number of
      device IDs.

  interrupts:
    minItems: 1
    maxItems: 16
    description:
      The presence of this property implies that given RISC-V IOMMU uses
      wired interrupts to notify the RISC-V HARTS (or CPUs).

  msi-parent:
    description:
      The presence of this property implies that given RISC-V IOMMU uses
      MSIx to notify the RISC-V HARTs (or CPUs). This property should be
      considered only when the interrupts property is absent.

  dma-coherent:
    description:
      Present if page table walks and DMA accessed made by the RISC-V IOMMU
      are cache coherent with the CPU.

  power-domains:
    maxItems: 1

required:
  - compatible
  - reg
  - '#iommu-cells'

additionalProperties: false

examples:
  - |
    /* Example 1 (IOMMU platform device with wired interrupts) */
    immu1: iommu@1bccd000 {
        compatible = "vendor,chip-iommu", "riscv,iommu";
        reg = <0x1bccd000 0x1000>;
        interrupt-parent = <&aplic_smode>;
        interrupts = <32 4>, <33 4>, <34 4>, <35 4>;
        #iommu-cells = <2>;
    };

    /* Device with two IOMMU device IDs, 0 and 7 */
    master1 {
        iommus = <&immu1 0 1>, <&immu1 7 1>;
    };

  - |
    /* Example 2 (IOMMU platform device with MSIs) */
    immu2: iommu@1bcdd000 {
        compatible = "vendor,chip-iommu", "riscv,iommu";
        reg = <0x1bccd000 0x1000>;
        msi-parent = <&imsics_smode>;
        #iommu-cells = <2>;
    };

    bus {
        #address-cells = <2>;
        #size-cells = <2>;

        /* Device with IOMMU device IDs ranging from 32 to 64 */
        master1 {
                iommus = <&immu2 32 32>;
        };

        pcie@40000000 {
            compatible = "pci-host-cam-generic";
            device_type = "pci";
            #address-cells = <3>;
            #size-cells = <2>;
            bus-range = <0x0 0x1>;

            /* CPU_PHYSICAL(2)  SIZE(2) */
            reg = <0x0 0x40000000 0x0 0x1000000>;

            /* BUS_ADDRESS(3)  CPU_PHYSICAL(2)  SIZE(2) */
            ranges = <0x01000000 0x0 0x01000000  0x0 0x01000000  0x0 0x00010000>,
                     <0x02000000 0x0 0x41000000  0x0 0x41000000  0x0 0x3f000000>;

            #interrupt-cells = <0x1>;

            /* PCI_DEVICE(3)  INT#(1)  CONTROLLER(PHANDLE)  CONTROLLER_DATA(2) */
            interrupt-map = <   0x0 0x0 0x0  0x1  &aplic_smode  0x4 0x1>,
                            < 0x800 0x0 0x0  0x1  &aplic_smode  0x5 0x1>,
                            <0x1000 0x0 0x0  0x1  &aplic_smode  0x6 0x1>,
                            <0x1800 0x0 0x0  0x1  &aplic_smode  0x7 0x1>;

            /* PCI_DEVICE(3)  INT#(1) */
            interrupt-map-mask = <0xf800 0x0 0x0  0x7>;

            msi-parent = <&imsics_smode>;

            /* Devices with bus number 0-127 are mastered via immu2 */
            iommu-map = <0x0000 &immu2 0x0000 0x8000>;
        };
    };
...
```

## Documentation/devicetree/bindings/mailbox/riscv,rpmi-shmem-mbox.yaml
```yaml
# SPDX-License-Identifier: (GPL-2.0-only OR BSD-2-Clause)
%YAML 1.2
---
$id: http://devicetree.org/schemas/mailbox/riscv,rpmi-shmem-mbox.yaml#
$schema: http://devicetree.org/meta-schemas/core.yaml#

title: RISC-V Platform Management Interface (RPMI) shared memory mailbox

maintainers:
  - Anup Patel <anup@brainfault.org>

description: |
  The RISC-V Platform Management Interface (RPMI) [1] defines a common shared
  memory based RPMI transport. This RPMI shared memory transport integrates as
  mailbox controller in the SBI implementation or supervisor software whereas
  each RPMI service group is mailbox client in the SBI implementation and
  supervisor software.

  ===========================================
  References
  ===========================================

  [1] RISC-V Platform Management Interface (RPMI)
      https://github.com/riscv-non-isa/riscv-rpmi/releases

properties:
  compatible:
    const: riscv,rpmi-shmem-mbox

  reg:
    oneOf:
      - items:
          - description: A2P request queue base address
          - description: P2A acknowledgment queue base address
          - description: P2A request queue base address
          - description: A2P acknowledgment queue base address
          - description: A2P doorbell address
      - items:
          - description: A2P request queue base address
          - description: P2A acknowledgment queue base address
          - description: P2A request queue base address
          - description: A2P acknowledgment queue base address
      - items:
          - description: A2P request queue base address
          - description: P2A acknowledgment queue base address
          - description: A2P doorbell address
      - items:
          - description: A2P request queue base address
          - description: P2A acknowledgment queue base address

  reg-names:
    oneOf:
      - items:
          - const: a2p-req
          - const: p2a-ack
          - const: p2a-req
          - const: a2p-ack
          - const: doorbell
      - items:
          - const: a2p-req
          - const: p2a-ack
          - const: p2a-req
          - const: a2p-ack
      - items:
          - const: a2p-req
          - const: p2a-ack
          - const: doorbell
      - items:
          - const: a2p-req
          - const: p2a-ack

  interrupts:
    maxItems: 1
    description:
      The RPMI shared memory transport supports wired interrupt specified by
      this property as the P2A doorbell.

  msi-parent:
    description:
      The RPMI shared memory transport supports MSI as P2A doorbell and this
      property specifies the target MSI controller.

  riscv,slot-size:
    $ref: /schemas/types.yaml#/definitions/uint32
    minimum: 64
    description:
      Power-of-2 RPMI slot size of the RPMI shared memory transport.

  riscv,doorbell-mask:
    $ref: /schemas/types.yaml#/definitions/uint32
    default: 0xffffffff
    description:
      Update only the register bits of doorbell defined by the mask (32 bit).

  riscv,doorbell-value:
    $ref: /schemas/types.yaml#/definitions/uint32
    default: 0x1
    description:
      Value written to the doorbell register bits (32-bit access) specified
      by the riscv,db-mask property.

  "#mbox-cells":
    const: 1
    description:
      The first cell specifies RPMI service group ID.

required:
  - compatible
  - reg
  - reg-names
  - riscv,slot-size
  - "#mbox-cells"

anyOf:
  - required:
      - interrupts
  - required:
      - msi-parent

additionalProperties: false

examples:
  - |
    // Example 1 (RPMI shared memory with only 2 queues):
    mailbox@10080000 {
        compatible = "riscv,rpmi-shmem-mbox";
        reg = <0x10080000 0x10000>,
              <0x10090000 0x10000>,
              <0x100a0000 0x4>;
        reg-names = "a2p-req", "p2a-ack", "doorbell";
        msi-parent = <&imsic_mlevel>;
        riscv,slot-size = <64>;
        #mbox-cells = <1>;
    };
  - |
    // Example 2 (RPMI shared memory with only 4 queues):
    mailbox@10001000 {
        compatible = "riscv,rpmi-shmem-mbox";
        reg = <0x10001000 0x800>,
              <0x10001800 0x800>,
              <0x10002000 0x800>,
              <0x10002800 0x800>,
              <0x10003000 0x4>;
        reg-names = "a2p-req", "p2a-ack", "p2a-req", "a2p-ack", "doorbell";
        msi-parent = <&imsic_mlevel>;
        riscv,slot-size = <64>;
        riscv,doorbell-mask = <0x00008000>;
        riscv,doorbell-value = <0x00008000>;
        #mbox-cells = <1>;
    };
```
